## conf/bblayers.conf.sample
```bitbake
BBLAYERS ?= " \
  ${TOPDIR}/../poky/meta \
  ${TOPDIR}/../poky/meta-poky \
  ${TOPDIR}/../meta-openembedded/meta-oe \
  ${TOPDIR}/../meta-openembedded/meta-networking \
  ${TOPDIR}/../meta-openembedded/meta-python \
  ${TOPDIR}/../meta-rdk-broadband-apps \
  ${TOPDIR}/../meta-amx \
  ${TOPDIR}/../meta-lcm \
"
```

## conf/layer.conf
```bitbake
# Where to scan for recipes
BBPATH .= ":${LAYERDIR}"
BBFILES += "${LAYERDIR}/recipes-*/*/*.bb \
            ${LAYERDIR}/recipes-*/*/*.bbappend "

BBFILE_COLLECTIONS += "meta-rdk-broadband-apps"
BBFILE_PATTERN_meta-rdk-broadband-apps = "^${LAYERDIR}/"
BBFILE_PRIORITY_meta-rdk-broadband-apps = 7

#Default set to DAC. Value can be DAC/LCM
RDK_BB_APPS_TOOLKIT_CRUNTIME ?= "DAC"
export RDK_BB_APPS_TOOLKIT_CRUNTIME

# Yocto/OE compatibility: Need to adjust to appropriate target
LAYERSERIES_COMPAT_meta-rdk-broadband-apps = "kirkstone mickledore nanbield scarthgap"

# Base deps (typical)
LAYERDEPENDS_meta-rdk-broadband-apps += "core openembedded-layer"

# NOTE: meta-amx/meta-lcm must be added to BBLAYERS explicitly;
# LAYERRECOMMENDS is advisory only
# LCM stack (Do we really need this?)
LAYERRECOMMENDS_rdkbbapps += \
"$(@bb.utils.contains('RDK_BB_APPS_TOOLKIT_CRUNTIME', 'LCM', 'meta-amx meta-lcm',' ', d)}"

# Help discovery if your workspace checks out layers under ../layers
BBLAYERS_SEARCH_DIRS ?= "\
    ${TOPDIR}/../layers \
    ${TOPDIR}/../sources \
    ${TOPDIR}/.. \
"
```
